## boards/shields/ahmedlearn/Kconfig.defconfig
```kconfig
if SHIELD_AHMEDLEARN

# Name must be less than 16 characters long!
config ZMK_KEYBOARD_NAME
    default "ahmedlearn"

config IQS5XX
    bool
    default y

# enable pointing
config ZMK_POINTING
    default y

config INPUT
    default y

endif
```

## boards/shields/osman_azo/Kconfig.defconfig
```kconfig
if SHIELD_osman_azo

# Name must be less than 16 characters long!
config ZMK_KEYBOARD_NAME
    default "osman_azo"

config IQS5XX
    bool
    default y

# enable pointing
config ZMK_POINTING
    default y

config INPUT
    default y

endif
```

## boards/shields/osman_azo/Kconfig.shield
```kconfig
config SHIELD_osman_azo_LEFT
    def_bool $(shields_list_contains, osman_azo_left)

config SHIELD_osman_azo_RIGHT
    def_bool $(shields_list_contains,osman_azo_right)
```

## config/west.yml
```yaml
manifest:
  remotes:
    - name: zmkfirmware
      url-base: https://github.com/zmkfirmware
    - name: ahmed-m-osman1
      url-base: https://github.com/Ahmed-M-Osman1
  projects:
    - name: zmk
      remote: zmkfirmware
      revision: main
      import: app/west.yml
    - name: zmk-driver-azoteq
      remote: ahmed-m-osman1
      # branch
      revision: fix-double-wait
  self:
    path: config
```
