/*
 * Copyright (c) 2022 The ZMK Contributors
 *
 * SPDX-License-Identifier: MIT
 */

#include <behaviors.dtsi>
#include <dt-bindings/zmk/keys.h>
#include <dt-bindings/zmk/bt.h>

/ {
    keymap {
        compatible = "zmk,keymap";

        default_layer {
            bindings = <
                &kp X
                &kp Z
            >;
        };
    };
};

&kscan0 {
    compatible = "zmk,kscan-gpio-direct";
    col-gpios
        = <&pro_micro_d 4 GPIO_ACTIVE_HIGH>
        , <&pro_micro_d 5 GPIO_ACTIVE_HIGH>
        ;
    row-gpios = <&pro_micro_d 6 GPIO_ACTIVE_HIGH> ;
    map = <
    RC(0,0) RC(0,1)
     >;
   };
